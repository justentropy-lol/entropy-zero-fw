## main/Kconfig.projbuild
```kconfig
menu "Additional Configuration"

    config SET_MAC_ADDRESS_OF_TARGET_AP
        bool "Set MAC address of target AP"
        default y

endmenu
```

## sdkconfig.defaults
```kconfig
CONFIG_LWIP_SO_LINGER=y
CONFIG_ESPTOOLPY_FLASHSIZE_8MB=y
CONFIG_ESPTOOLPY_FLASHSIZE="8MB"
CONFIG_ESP_MAIN_TASK_STACK_SIZE=8192
CONFIG_MAIN_TASK_STACK_SIZE=8192
```
